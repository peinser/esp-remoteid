## src/remoteid/Kconfig
```kconfig
menu "ESP Remote ID"

config REMOTEID_TRANSPORT_BLE
    bool "Enable Bluetooth LE legacy advertisements"
    default y
    help
        Broadcast OpenDroneID messages using BLE legacy advertisements with
        service UUID 0xFFFA. Disable this when testing Wi-Fi-only reception.

config REMOTEID_TRANSPORT_BLE5_LONG_RANGE
    bool "Enable Bluetooth 5 Long Range (LE Coded PHY)"
    default n
    help
        Broadcast OpenDroneID Message Packs (all messages in one
        advertisement) using BLE 5 extended advertising with LE Coded PHY (S=8
        coding). This increases range at the cost of a lower
        data rate and is a separate transport from BLE 4 legacy advertising.
        Both can be enabled simultaneously.

        Disabled by default. EU regulation 2019/945 does not list transports;
        it requires a broadcast that "can be received directly by existing
        mobile devices". Most phones cannot receive LE Coded PHY, so never use
        BLE 5 Long Range on its own in the EU: keep BLE 4 legacy (or Wi-Fi)
        enabled alongside it.

        Most current receiver apps do not yet support BLE 5 Long Range. Enable
        alongside BLE 4 for extended range, or alone when operating under FAA
        rules and targeting F3411-22a compatible receivers.

config REMOTEID_TRANSPORT_WIFI_BEACON
    bool "Enable Wi-Fi Beacon advertisements"
    default n
    help
        Broadcast OpenDroneID Message Pack payloads in Wi-Fi Beacon vendor
        information elements. This can be enabled together with BLE or used
        alone when testing receiver transport support.

config REMOTEID_TRANSPORT_WIFI_NAN
    bool "Enable Wi-Fi NAN advertisements"
    default n
    help
        Broadcast OpenDroneID Message Pack payloads in Wi-Fi Neighbor
        Awareness Networking sync/action frames. This is a separate transport
        from Wi-Fi Beacon and receiver apps may support one but not the other.

choice REMOTEID_IDENTITY_SOURCE
    prompt "Remote ID identity source"
    default REMOTEID_IDENTITY_STATIC
    help
        Where the broadcast identity (UAS ID, Operator ID, ID type, UA type,
        EU operation category and equipment class) comes from.

config REMOTEID_IDENTITY_STATIC
    bool "Static (configured here, flashed in)"
    help
        Identity is taken from the options below at build time. Use this for a
        standalone module on a fixed drone.

config REMOTEID_IDENTITY_RUNTIME
    bool "Runtime (provided over MAVLink / DroneCAN)"
    help
        Identity is left empty and undeclared at boot and supplied at runtime by
        a flight controller or GCS. The module stays not-ready (no broadcast)
        until a valid Basic ID and Operator ID arrive. The static identity
        options below are hidden in this mode, since they would only be
        overwritten by the incoming messages. In strict compliance mode the
        UAS ID still comes from eFuse and the UA type from the option below;
        only the Operator ID (and System data) come from the flight controller
        or GCS.

endchoice

config REMOTEID_UAS_ID
    string "UAS ID (max 20 characters)"
    depends on REMOTEID_IDENTITY_STATIC && !REMOTEID_COMPLIANCE_STRICT
    default "CHANGE_ME_UAS_ID"
    help
        The UAS ID broadcast in the Basic ID message. In the EU this is the
        ANSI/CTA-2063-A serial number of the Remote ID system: for an add-on
        module its own serial, for a built-in system the serial of the
        aircraft. It has the form <4-character manufacturer code><length
        character 1-F><serial>, using digits and upper-case letters without O
        and I, e.g. "1ABC5XYZ12".

        A CAA registration number can be used instead (ID type "CAA
        Registration ID"). Must be 20 characters or fewer. Not used in strict
        compliance mode, which reads the serial from eFuse.

config REMOTEID_OPERATOR_ID
    string "Operator registration ID (max 20 characters)"
    depends on REMOTEID_IDENTITY_STATIC
    default "CHANGE_ME_OP_ID"
    help
        Your national operator registration number as issued by your Civil
        Aviation Authority. For an EU number enter it with its 3 secret
        characters, e.g. "FIN87astrdge12k8-xyz": the checksum is verified
        against the secret part and only the 16 public characters are
        broadcast. Strict compliance mode accepts only this form.

config REMOTEID_COMPLIANCE_STRICT
    bool "Strict EU (EASA) compliance mode"
    depends on REMOTEID_MAVLINK_INPUT || REMOTEID_DRONECAN_INPUT
    default n
    help
        Enforce the EU direct remote identification rules (Regulation (EU)
        2019/945, Part 6 of the Annex) at runtime. Needs a live position
        source (MAVLink or DroneCAN input).

        - The UAS ID is the ANSI/CTA-2063-A serial number burned into the
          eFuse user data block (BLOCK_USR_DATA) at production, so neither
          input links nor a reflash can change it. Basic ID messages from
          MAVLink or DroneCAN are ignored. A malformed serial is never
          broadcast: the device stays not-ready, shows the error indicator and
          reports the failure to the autopilot.
        - The operator ID must be the full EU registration number with its 3
          secret characters. The checksum is verified and only the 16 public
          characters are stored and broadcast. A failed check is reported to
          the operator until a valid number is uploaded.
        - The aircraft Location is taken only from the bound autopilot (MAVLink)
          or the bound node (DroneCAN), never from a ground station, and the
          device is only ready to arm with a fresh Location that has a
          position, a height and a time stamp.
        - No fixed configured position, no start-up delay, and the OTA server
          only with Secure Boot (signed images).
        - At least one EN 4709-002 broadcast method is enabled: BLE 5 Long
          Range, Wi-Fi Beacon or Wi-Fi NAN. Keep BLE 4 legacy advertising on
          as well, since phones without those receivers rely on it.

        A production device also needs Secure Boot and flash encryption, so
        the position handling and the rest of the firmware cannot be changed
        by reflashing.

        When disabled, a malformed serial is logged as a warning but still
        broadcast, and a 16-character operator ID is accepted unverified
        (development convenience).

config REMOTEID_STARTUP_DELAY_MS
    int "Startup delay before transmissions (ms)"
    depends on !REMOTEID_COMPLIANCE_STRICT
    default 10000
    range 0 60000
    help
        Delay after boot before BLE or Wi-Fi Remote ID transmissions start.
        This is useful during development because it leaves time to attach the
        serial monitor after flashing or reset.

config REMOTEID_MAVLINK_INPUT
    bool "Enable MAVLink OpenDroneID input"
    default n
    help
        Parse incoming MAVLink v2 OpenDroneID messages from a flight controller
        or companion computer and feed them into the Remote ID state store.
        Supported messages are OPEN_DRONE_ID_BASIC_ID, OPEN_DRONE_ID_OPERATOR_ID,
        OPEN_DRONE_ID_LOCATION, OPEN_DRONE_ID_SYSTEM, OPEN_DRONE_ID_SELF_ID,
        OPEN_DRONE_ID_AUTHENTICATION, OPEN_DRONE_ID_MESSAGE_PACK and
        OPEN_DRONE_ID_SYSTEM_UPDATE, plus HEARTBEAT and SYSTEM_TIME from the
        autopilot (arm state, takeoff capture, UTC clock). Messages that
        describe another aircraft (id_or_mac set, or sent by an Open Drone ID
        transmitter/receiver component) are ignored.

if REMOTEID_MAVLINK_INPUT

choice REMOTEID_MAVLINK_TRANSPORT
    prompt "MAVLink transport"
    default REMOTEID_MAVLINK_TRANSPORT_UART
    help
        Physical link used to exchange MAVLink with the flight controller or
        companion computer.

config REMOTEID_MAVLINK_TRANSPORT_UART
    bool "UART"
    help
        Hardware UART. Requires wiring the RX (and optionally TX) GPIOs to the
        peer's serial port.

config REMOTEID_MAVLINK_TRANSPORT_USB_SERIAL_JTAG
    bool "USB Serial/JTAG (native USB device)"
    help
        Use the ESP32-S3 built-in USB Serial/JTAG peripheral on the native USB
        port (GPIO19/20) as a USB CDC device, exchanging MAVLink with a USB host
        such as a companion computer or SBC. No GPIO wiring is needed. Set the
        console secondary output to "None" so log text does not corrupt the
        MAVLink byte stream; the build will fail with a clear message otherwise.

endchoice

if REMOTEID_MAVLINK_TRANSPORT_UART

config REMOTEID_MAVLINK_UART_NUM
    int "MAVLink UART number"
    default 1
    range 0 2
    help
        ESP32-S3 UART peripheral used for MAVLink input. This selects the
        hardware UART block, not the physical pins. The ESP32-S3 GPIO matrix
        lets UART signals be routed to many different pins, so configure the RX
        and optional TX GPIOs below to match your board wiring.

config REMOTEID_MAVLINK_BAUD
    int "MAVLink UART baud rate"
    default 57600
    range 1200 921600
    help
        Baud rate for the MAVLink input UART. Common flight-controller values
        are 57600, 115200, and 921600.

config REMOTEID_MAVLINK_RX_GPIO
    int "MAVLink UART RX GPIO"
    default -1
    range -1 48
    help
        Physical ESP32-S3 GPIO used as the selected UART's RX signal. Connect
        this pin to the flight controller or companion computer MAVLink TX pin.
        This must be set to a valid GPIO when MAVLink input is enabled. Do not
        assume the UART number automatically selects a usable board pin.

config REMOTEID_MAVLINK_TX_GPIO
    int "MAVLink UART TX GPIO"
    default -1
    range -1 48
    help
        Optional physical ESP32-S3 GPIO used as the selected UART's TX signal.
        Connect this pin to the flight controller or companion computer MAVLink
        RX pin for bidirectional wiring. Receive-only OpenDroneID input does not
        need it, but it is required when status output (HEARTBEAT and
        OPEN_DRONE_ID_ARM_STATUS) is enabled below. Leave at -1 for RX only.

endif # REMOTEID_MAVLINK_TRANSPORT_UART

config REMOTEID_MAVLINK_TASK_STACK
    int "MAVLink input task stack size"
    default 4096
    range 3072 8192

config REMOTEID_MAVLINK_TARGET_SYSTEM
    int "Accepted MAVLink target system"
    default 0
    range 0 255
    help
        If non-zero, only OpenDroneID messages addressed to this target system
        or broadcast target 0 are accepted. Leave as 0 to accept all systems.

config REMOTEID_MAVLINK_TARGET_COMPONENT
    int "Accepted MAVLink target component"
    default 0
    range 0 255
    help
        If non-zero, only OpenDroneID messages addressed to this target
        component or broadcast target 0 are accepted. Leave as 0 to accept all
        components.

config REMOTEID_MAVLINK_EMERGENCY_FROM_HEARTBEAT
    bool "Derive ODID emergency status from autopilot HEARTBEAT"
    default n
    help
        Map the flight controller's HEARTBEAT system_status to the OpenDroneID
        operational status: MAV_STATE_EMERGENCY and MAV_STATE_FLIGHT_TERMINATION
        are broadcast as EMERGENCY. Useful when the LOCATION source does not set
        the ODID status itself. By default the emergency latches until a power
        cycle (see the latch option below). A latched self-test system-failure
        keeps precedence.

config REMOTEID_MAVLINK_EMERGENCY_INCLUDE_CRITICAL
    bool "Also treat MAV_STATE_CRITICAL (failsafe) as emergency"
    depends on REMOTEID_MAVLINK_EMERGENCY_FROM_HEARTBEAT
    default n
    help
        Include CRITICAL (e.g. RC or battery failsafe) as an OpenDroneID
        emergency. Off by default because routine failsafes such as a battery RTL
        set CRITICAL, which may be too aggressive to broadcast as an emergency.

config REMOTEID_MAVLINK_EMERGENCY_LATCH
    bool "Latch emergency status (clear only by power cycle)"
    depends on REMOTEID_MAVLINK_EMERGENCY_FROM_HEARTBEAT
    default y
    help
        Once an emergency is declared, keep broadcasting EMERGENCY until a power
        cycle; do not downgrade it automatically when the autopilot recovers.
        This is the safe, conservative behaviour (an emergency should not be
        silently erased) and is the default. Disable only for live tracking that
        follows the autopilot state up and down.

config REMOTEID_MAVLINK_STATUS_OUTPUT
    bool "Send HEARTBEAT and OPEN_DRONE_ID_ARM_STATUS to the flight controller"
    default n
    help
        Periodically transmit a MAVLink HEARTBEAT (component type Open Drone ID)
        and an OPEN_DRONE_ID_ARM_STATUS message back to the flight controller.
        ArduPilot uses these to detect that a Remote ID module is present and
        healthy, and (depending on DID_OPTIONS) can refuse to arm without them.
        Requires the MAVLink UART TX GPIO above to be set.

# Outgoing identity is shared by every MAVLink producer (status output and the
# operator-location loop), so it is available whenever either is enabled.
if REMOTEID_MAVLINK_STATUS_OUTPUT || REMOTEID_MAVLINK_OPERATOR_LOCATION_LOOP

config REMOTEID_MAVLINK_OWN_SYSTEM_ID
    int "Outgoing MAVLink system ID"
    default 0
    range 0 255
    help
        MAVLink system ID used for messages this module sends (HEARTBEAT,
        OPEN_DRONE_ID_ARM_STATUS, OPEN_DRONE_ID_SYSTEM_UPDATE). A Remote ID
        transmitter should share the flight controller's system ID. Leave at 0 to
        adopt the system ID seen in the flight controller's HEARTBEAT
        automatically (system ID 1 is used until one is observed).

config REMOTEID_MAVLINK_OWN_COMPONENT_ID
    int "Outgoing MAVLink component ID"
    default 236
    range 1 255
    help
        MAVLink component ID used for outgoing messages. 236, 237, and 238 are
        the Open Drone ID transmitter/receiver component IDs
        (MAV_COMP_ID_ODID_TXRX_1..3). Use a distinct value per module if several
        share one system ID.

endif # outgoing identity

if REMOTEID_MAVLINK_STATUS_OUTPUT

config REMOTEID_MAVLINK_STATUS_RATE_HZ
    int "Status output rate (Hz)"
    default 1
    range 1 10
    help
        How often HEARTBEAT and OPEN_DRONE_ID_ARM_STATUS are transmitted. 1 Hz
        matches the usual MAVLink heartbeat cadence and is sufficient for
        ArduPilot's arm gating.

endif # REMOTEID_MAVLINK_STATUS_OUTPUT

config REMOTEID_MAVLINK_OPERATOR_LOCATION_LOOP
    bool "Own the operator-location freshness loop (SYSTEM_UPDATE)"
    default n
    help
        Keep the OpenDroneID operator location fresh on the aircraft without the
        GCS staying connected. For a fixed operator location (FIXED/TAKEOFF) the
        firmware periodically transmits OPEN_DRONE_ID_SYSTEM_UPDATE (broadcast
        target 0/0) to the autopilot. A live (LIVE_GNSS) operator location is
        never republished; it expires as set by "Live operator-location expiry".
        The send timestamp is seeded from MAVLink SYSTEM_TIME. Requires an outbound MAVLink
        path: the TX GPIO on the UART transport, or USB Serial/JTAG (inherent).
        Operator-location status is reported via ARM_STATUS only when status
        output is also enabled.

if REMOTEID_MAVLINK_OPERATOR_LOCATION_LOOP

config REMOTEID_MAVLINK_OPERATOR_LOCATION_PERIOD_MS
    int "Fixed operator-location republish period (ms)"
    default 2000
    range 200 10000
    help
        Interval between OPEN_DRONE_ID_SYSTEM_UPDATE transmissions when a fixed
        operator location is active. 2000 ms (0.5 Hz) mirrors a typical GCS.

endif # REMOTEID_MAVLINK_OPERATOR_LOCATION_LOOP

endif # REMOTEID_MAVLINK_INPUT

config REMOTEID_OPERATOR_LOCATION_EXPIRY_MS
    int "Live operator-location expiry (ms)"
    depends on REMOTEID_MAVLINK_INPUT || REMOTEID_DRONECAN_INPUT
    default 10000
    range 1000 60000
    help
        A live (LIVE_GNSS) operator location whose source timestamp has not
        advanced within this window is stale. It is then replaced by the
        take-off point captured at arming (EU 2019/945: the position of the
        remote pilot or, if not available, the take-off point), or dropped
        when there is none. Only a newer source timestamp restores it.

config REMOTEID_DRONECAN_INPUT
    bool "Enable DroneCAN (ArduPilot OpenDroneID over CAN)"
    default n
    help
        Join the CAN bus as a DroneCAN node and take the Remote ID data from
        ArduPilot's OpenDroneID CAN backend (DID_CANDRIVER):

        - receives dronecan.remoteid.BasicID, Location, SelfID, System and
          OperatorID from the first node that sends them (the autopilot);
        - sends dronecan.remoteid.ArmStatus and uavcan.protocol.NodeStatus at
          1 Hz and answers uavcan.protocol.GetNodeInfo.

        On ArduPilot set DID_ENABLE=1, DID_CANDRIVER to the CAN driver of this
        bus (1 or 2) and DID_MAVPORT=-1. DroneCAN has no Authentication message.

if REMOTEID_DRONECAN_INPUT

config REMOTEID_DRONECAN_RX_GPIO
    int "DroneCAN RX GPIO"
    default -1
    range -1 48
    help
        Physical ESP32-S3 GPIO connected to the CAN transceiver RXD output.
        This must be configured when DroneCAN input is enabled.

config REMOTEID_DRONECAN_TX_GPIO
    int "DroneCAN TX GPIO"
    default -1
    range -1 48
    help
        Physical ESP32-S3 GPIO connected to the CAN transceiver TXD input.
        This must be configured when DroneCAN is enabled.

choice REMOTEID_DRONECAN_BITRATE
    prompt "DroneCAN bitrate"
    default REMOTEID_DRONECAN_BITRATE_1000000

config REMOTEID_DRONECAN_BITRATE_125000
    bool "125 kbit/s"

config REMOTEID_DRONECAN_BITRATE_250000
    bool "250 kbit/s"

config REMOTEID_DRONECAN_BITRATE_500000
    bool "500 kbit/s"

config REMOTEID_DRONECAN_BITRATE_1000000
    bool "1 Mbit/s"

endchoice

config REMOTEID_DRONECAN_NODE_ID
    int "DroneCAN node ID"
    default 100
    range 1 125
    help
        Static DroneCAN node ID of this module. It must be unique on the bus.
        ArduPilot's node allocation server accepts static node IDs; pick one it
        has not allocated to another device (see CAN_D1_UC_NODE and the node
        list in the ground station).

config REMOTEID_DRONECAN_TASK_STACK
    int "DroneCAN task stack size"
    default 4096
    range 3072 8192

endif # REMOTEID_DRONECAN_INPUT

choice REMOTEID_ID_TYPE
    prompt "UAS ID type"
    depends on REMOTEID_IDENTITY_STATIC && !REMOTEID_COMPLIANCE_STRICT
    default REMOTEID_ID_TYPE_SERIAL_NUMBER
    help
        ASTM F3411 ID type encoded in the BasicID message. The EU requires the
        ANSI/CTA-2063-A serial number; strict compliance mode always uses it.

config REMOTEID_ID_TYPE_SERIAL_NUMBER
    bool "Serial Number (ANSI/CTA-2063-A)"

config REMOTEID_ID_TYPE_CAA_REG
    bool "CAA Registration ID (operator/national registration number)"

endchoice

choice REMOTEID_UA_TYPE
    prompt "UA type"
    depends on REMOTEID_IDENTITY_STATIC || REMOTEID_COMPLIANCE_STRICT
    default REMOTEID_UA_TYPE_MULTIROTOR
    help
        Aircraft type declared in the BasicID message.

config REMOTEID_UA_TYPE_MULTIROTOR
    bool "Helicopter / Multirotor"

config REMOTEID_UA_TYPE_AEROPLANE
    bool "Fixed-wing aeroplane"

config REMOTEID_UA_TYPE_HYBRID_LIFT
    bool "Hybrid lift (VTOL fixed-wing)"

config REMOTEID_UA_TYPE_OTHER
    bool "Other"

endchoice

choice REMOTEID_EU_CATEGORY
    prompt "EU operation category"
    depends on REMOTEID_IDENTITY_STATIC
    default REMOTEID_EU_CATEGORY_OPEN
    help
        EU Drone Regulation operation category for the System message.
        Self-built drones without a class label typically operate under
        the Open category rules. Use Specific or Certified only if you
        hold the corresponding authorisation or type certificate.

config REMOTEID_EU_CATEGORY_UNDECLARED
    bool "Undeclared"

config REMOTEID_EU_CATEGORY_OPEN
    bool "Open"

config REMOTEID_EU_CATEGORY_SPECIFIC
    bool "Specific"

config REMOTEID_EU_CATEGORY_CERTIFIED
    bool "Certified"

endchoice

choice REMOTEID_EU_CLASS
    prompt "EU equipment class"
    depends on REMOTEID_IDENTITY_STATIC
    default REMOTEID_EU_CLASS_UNDECLARED
    help
        EU equipment class label for the System message. Self-built drones
        do not carry a class label; leave this as Undeclared. Only select
        C0 through C6 if your equipment bears the corresponding CE mark
        from the manufacturer.

config REMOTEID_EU_CLASS_UNDECLARED
    bool "Undeclared (self-built / no class label)"

config REMOTEID_EU_CLASS_C0
    bool "C0"

config REMOTEID_EU_CLASS_C1
    bool "C1"

config REMOTEID_EU_CLASS_C2
    bool "C2"

config REMOTEID_EU_CLASS_C3
    bool "C3"

config REMOTEID_EU_CLASS_C4
    bool "C4"

config REMOTEID_EU_CLASS_C5
    bool "C5"

config REMOTEID_EU_CLASS_C6
    bool "C6"

endchoice

config REMOTEID_HAS_POSITION
    bool "Broadcast a known takeoff position"
    depends on !REMOTEID_COMPLIANCE_STRICT
    default n
    help
        Enable to broadcast a configured static position in the Location
        and System messages, using the takeoff coordinates entered below.
        Disable if no GPS fix or known position is available: the messages
        will then carry the ASTM F3411 invalid sentinel values
        (lat=0, lon=0, alt=-1000 m, speed=invalid), which is the
        protocol-compliant way of indicating an unknown position.

if REMOTEID_HAS_POSITION

config REMOTEID_TAKEOFF_LAT_1E6
    int "Takeoff latitude (degrees × 10⁶)"
    default 0
    range -90000000 90000000
    help
        Latitude of the takeoff/operator location in degrees, multiplied
        by 10⁶ (six decimal places, ~11 cm resolution).
        Example: 50.962290° N → 50962290.

config REMOTEID_TAKEOFF_LON_1E6
    int "Takeoff longitude (degrees × 10⁶)"
    default 0
    range -180000000 180000000
    help
        Longitude of the takeoff/operator location in degrees, multiplied
        by 10⁶ (six decimal places, ~11 cm resolution).
        Example: 4.454977° E → 4454977.

config REMOTEID_TAKEOFF_ALT_M
    int "Takeoff altitude above WGS-84 ellipsoid (metres)"
    default 0
    range -1000 9000
    help
        Altitude of the takeoff point above the WGS-84 ellipsoid in whole
        metres. Obtain this value from a GNSS receiver or an online
        mapping service. This is not the altitude above sea level (AMSL)
        unless your area has negligible geoid undulation.

endif # REMOTEID_HAS_POSITION

choice REMOTEID_BLE_TX_POWER
    prompt "BLE advertising TX power"
    depends on REMOTEID_TRANSPORT_BLE
    default REMOTEID_BLE_TX_POWER_P9
    help
        BLE Remote ID uses a power-based expectation rather than a guaranteed
        reception distance. Select the highest level allowed by the board,
        antenna, enclosure, and local RF constraints for range testing.

config REMOTEID_BLE_TX_POWER_N12
    bool "-12 dBm"

config REMOTEID_BLE_TX_POWER_N9
    bool "-9 dBm"

config REMOTEID_BLE_TX_POWER_N6
    bool "-6 dBm"

config REMOTEID_BLE_TX_POWER_N3
    bool "-3 dBm"

config REMOTEID_BLE_TX_POWER_N0
    bool "0 dBm"

config REMOTEID_BLE_TX_POWER_P3
    bool "+3 dBm"

config REMOTEID_BLE_TX_POWER_P6
    bool "+6 dBm"

config REMOTEID_BLE_TX_POWER_P9
    bool "+9 dBm"

endchoice

config REMOTEID_BLE_TX_INTERVAL_MS
    int "BLE advertisement rotation interval (ms)"
    default 250
    range 100 260
    depends on REMOTEID_TRANSPORT_BLE || REMOTEID_TRANSPORT_BLE5_LONG_RANGE
    help
        Interval between BLE advertisement payload updates. BLE 5 Long Range
        sends the whole Message Pack (every message) once per interval. For
        BLE 4 legacy advertising, one message per interval: the schedule has
        9 slots (Location and System in every third slot) plus up to four
        100 ms authentication slots between them. At the 260 ms maximum
        Location and System are still sent at least once per second
        (3 x 260 + 200 = 980 ms) and every other message at least every 3 s
        (9 x 260 + 400 = 2740 ms); larger values would break those rates.

config REMOTEID_INDICATOR_RGB_ENABLE
    bool "Enable onboard RGB status indicator"
    default n
    help
        Drive a board-mounted addressable RGB LED, typically WS2812/SK6812, as
        a local firmware status indicator. Before Remote ID is operational it
        shows status/error indications. After transports have started and valid
        identity is present, it switches to the configured operational flash
        pattern. This is separate from the TX status LED pulse output.

if REMOTEID_INDICATOR_RGB_ENABLE

config REMOTEID_INDICATOR_RGB_GPIO
    int "Onboard RGB LED data GPIO"
    default 48
    range -1 48
    help
        Physical ESP32-S3 GPIO connected to the onboard addressable RGB LED data
        input. The UICPAL ESP32-S3-N16R8 board variant used by this firmware
        uses GPIO48 for its WS2812 RGB LED. Other ESP32-S3 dev boards may use
        GPIO33 or another pin, so verify your board schematic before enabling
        this option on non-UICPAL hardware. Set to -1 to leave the indicator
        disabled even when this menu section is enabled.

config REMOTEID_INDICATOR_RGB_BRIGHTNESS_PERCENT
    int "Onboard RGB LED brightness (%)"
    default 16
    range 1 100
    help
        Scales the local indicator LED brightness. This only affects the
        onboard RGB status LED, not any future external light trigger GPIOs.

choice REMOTEID_INDICATOR_OPERATIONAL_PATTERN
    prompt "Onboard RGB operational flash pattern"
    default REMOTEID_INDICATOR_PATTERN_DRONE_BEACON_1HZ_SHORT
    help
        Pattern used by the onboard RGB LED after Remote ID is operational.
        External aviation lighting outputs will be configured separately later.

config REMOTEID_INDICATOR_PATTERN_SOLID
    bool "Solid on"

config REMOTEID_INDICATOR_PATTERN_DRONE_BEACON_1HZ_SHORT
    bool "Drone beacon 1 Hz short flash"

config REMOTEID_INDICATOR_PATTERN_DRONE_BEACON_1HZ_50
    bool "Drone beacon 1 Hz 50% duty"

config REMOTEID_INDICATOR_PATTERN_STROBE_SINGLE
    bool "Single strobe"

config REMOTEID_INDICATOR_PATTERN_STROBE_DOUBLE
    bool "Double strobe"

config REMOTEID_INDICATOR_PATTERN_STROBE_TRIPLE
    bool "Triple strobe"

config REMOTEID_INDICATOR_PATTERN_FAST_STROBE
    bool "Fast strobe"

endchoice

endif # REMOTEID_INDICATOR_RGB_ENABLE

rsource "Kconfig.lighting"

if REMOTEID_TRANSPORT_WIFI_BEACON || REMOTEID_TRANSPORT_WIFI_NAN

config REMOTEID_WIFI_CHANNEL
    int "Wi-Fi Remote ID channel"
    default 6
    range 1 13
    help
        2.4 GHz Wi-Fi channel used for Wi-Fi Remote ID transmission. Channel
        6 is the standard/default channel for ASTM F3411 Wi-Fi Beacon/NAN on
        2.4 GHz. Select a different channel only when permitted and required.

config REMOTEID_WIFI_TX_POWER_DBM
    int "Wi-Fi TX power (dBm)"
    default 20
    range 2 20
    help
        Wi-Fi transmit power in dBm. ESP-IDF accepts quarter-dBm units; the
        firmware converts this integer value internally. Keep this within
        your antenna, enclosure, and local RF limits.

endif # REMOTEID_TRANSPORT_WIFI_BEACON || REMOTEID_TRANSPORT_WIFI_NAN

if REMOTEID_TRANSPORT_WIFI_BEACON

config REMOTEID_WIFI_BEACON_SSID
    string "Wi-Fi Beacon SSID"
    default "OpenDroneID"
    help
        SSID carried in the Remote ID Wi-Fi Beacon frame. Keep this at 32
        bytes or fewer. Remote ID receivers should parse the vendor IE, not
        rely on this SSID.

config REMOTEID_WIFI_BEACON_TX_INTERVAL_MS
    int "Wi-Fi Beacon TX interval (ms)"
    default 1000
    range 100 1000
    help
        Interval between OpenDroneID Wi-Fi Beacon transmissions. Every frame
        carries the Location, so the interval must not exceed 1000 ms (1 Hz).

endif # REMOTEID_TRANSPORT_WIFI_BEACON

if REMOTEID_TRANSPORT_WIFI_NAN

config REMOTEID_WIFI_NAN_TX_INTERVAL_MS
    int "Wi-Fi NAN TX interval (ms)"
    default 1000
    range 100 1000
    help
        Interval between OpenDroneID Wi-Fi NAN sync/action transmissions. Every
        frame carries the Location, so the interval must not exceed 1000 ms.

endif # REMOTEID_TRANSPORT_WIFI_NAN

config REMOTEID_FLASH_ENC_RELEASE_CONFIRM
    string "Flash encryption Release mode confirmation"
    default ""
    depends on SECURE_FLASH_ENC_ENABLED
    help
        Flash encryption Release mode permanently burns eFuses on first boot that
        disable serial flashing and JTAG. This cannot be reversed without replacing
        the SoC. A device in Release mode without a working OTA path is permanently
        unrecoverable.

        Type UNRECOVERABLE (all caps, exactly) to allow the build to proceed when
        CONFIG_SECURE_FLASH_ENCRYPTION_MODE_RELEASE is set. Leaving this blank
        while Release mode is enabled will cause an explicit build failure.

menu "OTA update server"

config REMOTEID_OTA_ENABLE
    bool "Enable OTA update server"
    depends on !REMOTEID_COMPLIANCE_STRICT || SECURE_BOOT
    default n
    help
        When triggered, the device starts a Wi-Fi access point and a lightweight
        HTTP management server. All normal Remote ID operations are suspended
        while the OTA server is running. The device restarts after any management
        operation (firmware update, factory reset, rollback, or NVS write) to
        resume normal operation.

        Trigger methods are configured below. The default trigger is a GPIO
        that must be held low at boot. A Kconfig option is also available to
        always enter OTA mode on every boot for development purposes.

if REMOTEID_OTA_ENABLE

config REMOTEID_OTA_TRIGGER_GPIO
    int "OTA trigger GPIO (active-low, -1 to disable)"
    default -1
    range -1 48
    help
        Physical ESP32-S3 GPIO sampled at boot to decide whether to enter OTA
        mode. Connect a momentary push-button between this pin and GND; an
        internal pull-up is enabled automatically. Hold the button during reset
        to enter OTA mode.

        Set to -1 to disable GPIO triggering. In that case OTA mode is only
        entered when REMOTEID_OTA_ALWAYS_ENTER is enabled.

config REMOTEID_OTA_ALWAYS_ENTER
    bool "Always enter OTA mode on boot (development only)"
    default n
    help
        Skip the GPIO check and always start the OTA HTTP server. Normal Remote
        ID operations never start. Intended for development and bench testing of
        the OTA server only. Do not enable in production firmware.

config REMOTEID_OTA_AP_SSID
    string "OTA Wi-Fi AP SSID"
    default "RemoteID-OTA"
    help
        SSID broadcast by the device while the OTA server is running. Connect
        to this network from a laptop or phone to reach the management server
        at http://192.168.4.1.

config REMOTEID_OTA_AP_PASSWORD
    string "OTA Wi-Fi AP password"
    default ""
    help
        WPA2 passphrase for the OTA access point. Must be at least 8 characters
        to enable WPA2; leave blank (fewer than 8 characters) for an open AP.
        Use a strong passphrase in any environment where unauthorized users
        could connect; the HTTP server has no additional authentication layer.

config REMOTEID_OTA_AP_CHANNEL
    int "OTA Wi-Fi AP channel"
    default 6
    range 1 13
    help
        2.4 GHz Wi-Fi channel used for the OTA access point. Change this only
        if channel 6 conflicts with nearby infrastructure during maintenance.

config REMOTEID_OTA_HTTP_PORT
    int "OTA HTTP server port"
    default 80
    range 1 65535
    help
        TCP port the OTA HTTP server listens on. The default port 80 allows
        plain http://192.168.4.1 URLs without a port suffix.

endif # REMOTEID_OTA_ENABLE

endmenu

menu "Authentication"

choice REMOTEID_AUTH_SOURCE
    prompt "Authentication message source"
    default REMOTEID_AUTH_RELAY
    help
        Where the broadcast Authentication pages come from. Exactly one source
        is used, so pages of two signatures are never mixed.

config REMOTEID_AUTH_RELAY
    bool "Relay from MAVLink (ground station or autopilot)"
    depends on REMOTEID_MAVLINK_INPUT
    help
        Broadcast the Authentication pages received in
        OPEN_DRONE_ID_AUTHENTICATION or inside OPEN_DRONE_ID_MESSAGE_PACK,
        byte for byte as the signer produced them. A set goes on air once
        page 0 and every page up to its last page index have arrived, and is
        dropped when page 0 has not been received for 10 s.

        The signer must sign what this module broadcasts. UAS ID, Operator
        ID, Network Remote ID and specific-method pages verify as relayed. A
        message set signature only verifies if it covers the exact messages
        this module encodes and broadcasts. DroneCAN has no Authentication
        message, so this needs MAVLink input.

config REMOTEID_AUTH_NONE
    bool "None"

config REMOTEID_AUTH_ED25519
    bool "Local Ed25519 message set signature (key on this module)"
    help
        Signs the message set (Basic ID + Location + System + Operator ID +
        Self ID, 125 bytes, in that order) followed by the 4-byte
        little-endian page 0 timestamp, using Ed25519, and broadcasts the
        64-byte signature across four authentication pages (ASTM F3411-22a
        message set signature). The signing key lives on this module.

        The private key is read from REMOTEID_AUTH_PRIVATE_KEY_PEM or NVS
        (PKCS#8 PEM format). The corresponding public key is derived and
        logged at startup. Register it with your CA or verification service.
        A missing or invalid key is reported as a Remote ID system failure.

endchoice

config REMOTEID_AUTH_PRIVATE_KEY_PEM
    string "Ed25519 private key (PKCS#8 PEM)"
    depends on REMOTEID_AUTH_ED25519
    default ""
    help
        The Ed25519 private key in PKCS#8 PEM format, with newlines
        replaced by \n. Only Ed25519 keys are accepted; P-256/ECDSA
        keys will be rejected at startup.

        Generate a key:
          openssl genpkey -algorithm ed25519 -out device.pem

        Format for this field (one line, \n as separator):
          awk 'NF {printf "%s\\n", $0}' device.pem

        The key should look like:
          -----BEGIN PRIVATE KEY-----\nMC4CAQAwBQYD...\n-----END PRIVATE KEY-----\n

        The corresponding public key is logged at INFO level on startup.
        Register it with your CA or verification service.

        Keep this value secret: never commit an sdkconfig that contains a
        key. For production, leave this empty and provision the key in NVS.

endmenu

endmenu
```
